## components/Led/Kconfig
```kconfig
menu "LED Configuration Menu"

    config EXAMPLE_USE_LED
        bool "Use LED in this system"
        default n

    config EXAMPLE_USE_WS2812
        bool "LED WS2812"
        default n
        depends on EXAMPLE_USE_LED
        
    config EXAMPLE_NUMBER_OF_WS2812_LED
        int "Number of LEDs Connected"
        default 0
        range 0 31
        depends on EXAMPLE_USE_WS2812

    config EXAMPLE_WS2812_DATA_PIN
        int "DATA PIN"
        default 0
        range 0 31
        depends on EXAMPLE_USE_WS2812
endmenu
```

## components/stepperMotor/Kconfig
```kconfig
menu "Stepper Motor Configuration"
    config EXAMPLE_STEPPER_MOTOR_DIR_PIN
        int "Motor DIR Pin Number"
        default 0
        range 0 31
        help
            Pin number of Stepper Motor Dir Pin.

    config EXAMPLE_STEPPER_MOTOR_STEP_PIN
        int "Motor STEP Pin Number"
        default 0
        range 0 31
        help
            Pin number of Stepper Motor Step Pin.

    config EXAMPLE_STEPPER_MOTOR_ENABLE_PIN
        int "Motor ENABLE Pin Number"
        default 0
        range 0 31
        help
            Pin number of Stepper Motor Enable Pin.
    
endmenu
```

## main/Kconfig.projbuild
```kconfig
menu "Project Configuration"

    choice EXAMPLE_MODEM_DEVICE
        prompt "Choose supported modem device (DCE)"
        default EXAMPLE_MODEM_DEVICE_BG96
        help
            Select modem device connected to the ESP DTE.
        config EXAMPLE_MODEM_DEVICE_SIM800
            bool "SIM800"
            help
                SIMCom SIM800L is a GSM/GPRS module.
                It supports Quad-band 850/900/1800/1900MHz.
        config EXAMPLE_MODEM_DEVICE_BG96
            bool "BG96"
            help
                Quectel BG96 is a series of LTE Cat M1/Cat NB1/EGPRS module.
        config EXAMPLE_MODEM_DEVICE_SIM7600
            bool "SIM7600"
            help
                SIM7600 is Multi-Band LTE-TDD/LTE-FDD/HSPA+ and GSM/GPRS/EDGE module
    endchoice

    config EXAMPLE_MODEM_PPP_AUTH_USERNAME
        string "Set username for authentication"
        default "espressif"
        depends on !EXAMPLE_MODEM_PPP_AUTH_NONE
        help
            Set username for PPP Authentication.

    config EXAMPLE_MODEM_PPP_AUTH_PASSWORD
        string "Set password for authentication"
        default "esp32"
        depends on !EXAMPLE_MODEM_PPP_AUTH_NONE
        help
            Set password for PPP Authentication.

    config EXAMPLE_MODEM_PPP_AUTH_NONE
        bool "Skip PPP authentication"
        default n
        help
            Set to true for the PPP client to skip authentication

    config EXAMPLE_SEND_MSG
        bool "Short message (SMS)"
        default n
        help
            Select this, the modem will send a short message before power off.

    if EXAMPLE_SEND_MSG
        config EXAMPLE_SEND_MSG_PEER_PHONE_NUMBER
            string "Peer Phone Number (with area code)"
            default "+8610086"
            help
                Enter the peer phone number that you want to send message to.
    endif

    config EXAMPLE_UART_ISR_IN_RAM
        bool "Use UART ISR in RAM"
        default n
        select UART_ISR_IN_IRAM
        help
            Enable placing UART ISR to IRAM.
            This options is useful if PPPoS client needs to perform
            flash operations (e.g. OTA) while keeping the network operational.

    config EXAMPLE_LCP_ECHO
        bool "Enable LCP ECHO"
        default n
        select LWIP_ENABLE_LCP_ECHO
        help
            Enable this option to make use of LCP keepalive using
            LCP_ECHO_INTERVAL and LCP_MAXECHOFAILS to default values

    menu "UART Configuration"
        config EXAMPLE_MODEM_UART_TX_PIN
            int "TXD Pin Number"
            default 25
            range 0 31
            help
                Pin number of UART TX.

        config EXAMPLE_MODEM_UART_RX_PIN
            int "RXD Pin Number"
            default 26
            range 0 31
            help
                Pin number of UART RX.

        config EXAMPLE_MODEM_UART_RTS_PIN
            int "RTS Pin Number"
            default 27
            range 0 31
            help
                Pin number of UART RTS.

        config EXAMPLE_MODEM_UART_CTS_PIN
            int "CTS Pin Number"
            default 23
            range 0 31
            help
                Pin number of UART CTS.

        config EXAMPLE_MODEM_UART_EVENT_TASK_STACK_SIZE
            int "UART Event Task Stack Size"
            range 2000 6000
            default 3072
            help
                Stack size of UART event task.

        config EXAMPLE_MODEM_UART_EVENT_TASK_PRIORITY
            int "UART Event Task Priority"
            range 3 22
            default 5
            help
                Priority of UART event task.

        config EXAMPLE_MODEM_UART_EVENT_QUEUE_SIZE
            int "UART Event Queue Size"
            range 10 40
            default 30
            help
                Length of UART event queue.

        config EXAMPLE_MODEM_UART_PATTERN_QUEUE_SIZE
            int "UART Pattern Queue Size"
            range 10 40
            default 20
            help
                Length of UART pattern queue.

        config EXAMPLE_MODEM_UART_TX_BUFFER_SIZE
            int "UART TX Buffer Size"
            range 256 2048
            default 512
            help
                Buffer size of UART TX buffer.

        config EXAMPLE_MODEM_UART_RX_BUFFER_SIZE
            int "UART RX Buffer Size"
            range 256 2048
            default 1024
            help
                Buffer size of UART RX buffer.
    endmenu


    menu "LED Configuration"
        config EXAMPLE_RMT_TX_GPIO
            int "RMT TX GPIO"
            default 18
            help
                Set the GPIO number used for transmitting the RMT signal.
    
        config EXAMPLE_STRIP_LED_NUMBER
            int "Number of LEDS in a strip"
            default 24
            help
                A single RGB strip contains several LEDs.
    endmenu

    menu "SD Card Http_File_Serving menu"

        config EXAMPLE_MOUNT_SD_CARD
            bool "Mount the SD card to the filesystem"
            default n
            help
                If this config item is set, the file you upload to server can be chosen to save in the SDcard.
    
        config EXAMPLE_FORMAT_IF_MOUNT_SDCARD_FAILED
            bool "The card will be formatted if mount has failed."
            default n
            depends on EXAMPLE_MOUNT_SD_CARD
            help
                If this config item is set, the card will be formatted if mount has failed.
    
        config EXAMPLE_USE_SDMMC_HOST
            bool "Use SDMMC host"
            default y
            depends on EXAMPLE_MOUNT_SD_CARD && IDF_TARGET_ESP32
            help
                If this config item is set, SDMMC is used to mount the SDcard.
                Otherwise, will use SPI host to access and mount the SDcard.
    
        config EXAMPLE_HTTPD_CONN_CLOSE_HEADER
            bool "Send connection close header from request handlers"
            default y
            help
                If this config item is set, Connection: close header will be set in handlers.
                This closes HTTP connection and frees the server socket instantly.
    endmenu
    

endmenu
```
